/dts-v1/;
/plugin/;

/ {
    fragment@0 {
        target = <&i2c8>;

        __overlay__ {
            #address-cells = <1>;
            #size-cells = <0>;

            mpu6050@68 {
                compatible = "invensense,mpu6050";
                reg = <0x68>;
                status = "okay";
            };
        };
    };
};
